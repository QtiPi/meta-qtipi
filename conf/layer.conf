## conf/layer.conf
```bitbake
# We have a conf and classes directory, add to BBPATH
BBPATH .= ":${LAYERDIR}"

# We have recipes-* directories, add to BBFILES
BBFILES += "${LAYERDIR}/recipes-*/*/*.bb \
	${LAYERDIR}/recipes-*/*/*.bbappend"

BBFILE_COLLECTIONS += "qtipi"
BBFILE_PATTERN_qtipi = "^${LAYERDIR}/"
BBFILE_PRIORITY_qtipi = "10"

LAYERSERIES_COMPAT_qtipi = "sumo"
```
